## drivers/i2c/chips/Kconfig
```kconfig
#
# Miscellaneous I2C chip drivers configuration
#
# *** DEPRECATED! Do not add new entries! See Makefile ***
#

menu "Miscellaneous I2C Chip support"

config ALS_TSL2583_ZTE
	tristate "TSL2583 ALS Driver"
	depends on I2C
	help
	 TSL2583 ALS Driver implemented by TAOS.

config PROX_TMD26713_ZTE 
	tristate "TMD26713 prox Driver"
	depends on I2C
	help
	 TMD26713 PROX Driver implemented by TAOS.

config ALS_PROX_TMD27713_ZTE 
	tristate "TMD27713 ALS & prox Driver"
	depends on I2C
	help
	 TMD27713 ALS & PROX Driver implemented by TAOS.

endmenu
```
